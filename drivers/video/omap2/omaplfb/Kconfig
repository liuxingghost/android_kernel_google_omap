## drivers/video/omap2/omaplfb/Kconfig
```kconfig
config OMAPLFB
        bool "In-kernel omaplfb: interface between display and kernel side PowerVR graphics driver"
	default y
	help
	  Support for in-kernel omaplfb. This is used by PVR kernel module.
```
